#include "main.h"
#include <stdio.h>
#include <string.h>

/* UART HANDLES */
UART_HandleTypeDef huart1;
UART_HandleTypeDef huart2;

/* FUNCTION DECLARATIONS */
void SystemClock_Config(void);
static void MX_GPIO_Init(void);
static void MX_USART1_UART_Init(void);
static void MX_USART2_UART_Init(void);
void Error_Handler(void);

/* CONFIGURATION */
#define COMMAND_SIZE        128
#define RX_BUFFER_SIZE      2048
#define IPD_HEADER_SIZE     64
#define HTTP_RESPONSE_SIZE  1024

/* PC COMMAND BUFFER */
static uint8_t pcData;
static char commandBuffer[COMMAND_SIZE];
static uint16_t commandLength = 0;
static uint8_t ignoreNextLF = 0;

/* WEMOS INTERRUPT RECEIVE BUFFER */
static uint8_t wemosRxByte;
static uint8_t rxBuffer[RX_BUFFER_SIZE];
static volatile uint16_t rxHead = 0;
static volatile uint16_t rxTail = 0;
static volatile uint8_t rxOverflow = 0;

/* HTTP REQUEST PARSER */
static char ipdHeader[IPD_HEADER_SIZE];
static uint16_t ipdHeaderLength = 0;
static int connectionId = -1;
static int payloadRemaining = 0;

/* HTTP RESPONSE AND COUNTER */
static uint32_t pageCounter = 0;
static char httpResponse[HTTP_RESPONSE_SIZE];
static int httpResponseLength = 0;

/* HTTP states: 0 = wait request, 1 = wait '>', 2 = wait SEND OK */
static uint8_t httpState = 0;
static char recentText[32];

/* HELPER FUNCTION DECLARATIONS */
static void SendWemosText(const char *text);
static void ProcessWemosByte(uint8_t data);
static void PrepareHttpResponse(void);
static void StartHttpSend(void);
static void AddRecentCharacter(char data);

static void SendWemosText(const char *text)
{
    if (HAL_UART_Transmit(&huart1, (uint8_t *)text, (uint16_t)strlen(text), 1000) != HAL_OK)
    {
        Error_Handler();
    }
}

static void AddRecentCharacter(char data)
{
    size_t length = strlen(recentText);
    if (length >= sizeof(recentText) - 1)
    {
        memmove(recentText, recentText + 1, sizeof(recentText) - 2);
        length = sizeof(recentText) - 2;
    }
    recentText[length] = data;
    recentText[length + 1] = '\0';
}

static void PrepareHttpResponse(void)
{
    char body[700];
    int bodyLength;
    int responseLength;

    pageCounter++;

    bodyLength = snprintf(
        body,
        sizeof(body),
        "<!DOCTYPE html>"
        "<html>"
        "<head>"
        "<meta name=\"viewport\" content=\"width=device-width,initial-scale=1\">"
        "<title> Students of Dr.Dinesh G : STM32 Counter</title>"
        "</head>"
        "<body style=\"font-family:Arial;text-align:center;margin-top:60px\">"
        "<h1>STM32 + Wemos</h1>"
        "<h2>Counter by student of Dr . Dinesh G</h2>"
        "<p style=\"font-size:52px\">%lu</p>"
        "<p>Counter generated by STM32</p>"
        "</body>"
        "</html>",
        (unsigned long)pageCounter);

    if (bodyLength < 0 || bodyLength >= (int)sizeof(body))
    {
        httpState = 0;
        return;
    }

    responseLength = snprintf(
        httpResponse,
        sizeof(httpResponse),
        "HTTP/1.1 200 OK\r\n"
        "Content-Type: text/html; charset=utf-8\r\n"
        "Content-Length: %d\r\n"
        "Connection: close\r\n"
        "Cache-Control: no-store\r\n"
        "\r\n"
        "%s",
        bodyLength,
        body);

    if (responseLength < 0 || responseLength >= (int)sizeof(httpResponse))
    {
        httpState = 0;
        return;
    }

    httpResponseLength = responseLength;
    StartHttpSend();
}

static void StartHttpSend(void)
{
    char command[48];
    if (connectionId < 0 || httpResponseLength <= 0)
    {
        httpState = 0;
        return;
    }

    httpState = 1;
    recentText[0] = '\0';

    snprintf(command, sizeof(command), "AT+CIPSEND=%d,%d\r\n", connectionId, httpResponseLength);
    SendWemosText(command);
}

static void ProcessWemosByte(uint8_t data)
{
    if (HAL_UART_Transmit(&huart2, &data, 1, 100) != HAL_OK)
    {
        Error_Handler();
    }

    AddRecentCharacter((char)data);

    /* STATE 1: WAIT FOR '>' PROMPT */
    if (httpState == 1)
    {
        if (data == '>')
        {
            httpState = 2;
            recentText[0] = '\0';

            if (HAL_UART_Transmit(&huart1, (uint8_t *)httpResponse, (uint16_t)httpResponseLength, 3000) != HAL_OK)
            {
                Error_Handler();
            }
        }
        else if (strstr(recentText, "ERROR") != NULL)
        {
            httpState = 0;
            recentText[0] = '\0';
        }
        return;
    }

    /* STATE 2: WAIT FOR SEND OK */
    if (httpState == 2)
    {
        if (strstr(recentText, "SEND OK") != NULL)
        {
            char closeCommand[32];
            snprintf(closeCommand, sizeof(closeCommand), "AT+CIPCLOSE=%d\r\n", connectionId);
            httpState = 0;
            recentText[0] = '\0';
            SendWemosText(closeCommand);
        }
        else if (strstr(recentText, "SEND FAIL") != NULL || strstr(recentText, "ERROR") != NULL)
        {
            httpState = 0;
            recentText[0] = '\0';
        }
        return;
    }

    /* RECEIVE THE CURRENT +IPD PAYLOAD */
    if (payloadRemaining > 0)
    {
        payloadRemaining--;
        if (payloadRemaining == 0)
        {
            PrepareHttpResponse();
        }
        return;
    }

    /* COLLECT THE +IPD HEADER */
    if (ipdHeaderLength >= sizeof(ipdHeader) - 1)
    {
        memmove(ipdHeader, ipdHeader + 1, sizeof(ipdHeader) - 2);
        ipdHeaderLength = sizeof(ipdHeader) - 2;
    }

    ipdHeader[ipdHeaderLength++] = (char)data;
    ipdHeader[ipdHeaderLength] = '\0';

    if (data == ':')
    {
        char *ipd = strstr(ipdHeader, "+IPD,");
        if (ipd != NULL)
        {
            int id;
            int length;
            if (sscanf(ipd, "+IPD,%d,%d:", &id, &length) == 2)
            {
                if (id >= 0 && length > 0 && length < RX_BUFFER_SIZE)
                {
                    connectionId = id;
                    payloadRemaining = length;
                }
            }
        }
        ipdHeaderLength = 0;
        ipdHeader[0] = '\0';
    }
}

void HAL_UART_RxCpltCallback(UART_HandleTypeDef *huart)
{
    if (huart->Instance == USART1)
    {
        uint16_t next = (uint16_t)((rxHead + 1U) % RX_BUFFER_SIZE);
        if (next != rxTail)
        {
            rxBuffer[rxHead] = wemosRxByte;
            rxHead = next;
        }
        else
        {
            rxOverflow = 1;
        }

        if (HAL_UART_Receive_IT(&huart1, &wemosRxByte, 1) != HAL_OK)
        {
            rxOverflow = 1;
        }
    }
}

int main(void)
{
    HAL_Init();
    SystemClock_Config();
    MX_GPIO_Init();
    MX_USART1_UART_Init();
    MX_USART2_UART_Init();

    const char message[] =
        "\r\nSTM32-WEMOS HTTP COUNTER READY\r\n"
        "USART1: Wemos ESP8266\r\n"
        "USART2: PC / PuTTY\r\n\r\n";

    HAL_UART_Transmit(&huart2, (uint8_t *)message, sizeof(message) - 1, HAL_MAX_DELAY);

    if (HAL_UART_Receive_IT(&huart1, &wemosRxByte, 1) != HAL_OK)
    {
        Error_Handler();
    }

    while (1)
    {
        /* 1. PROCESS BUFFERED WEMOS DATA */
        while (rxTail != rxHead)
        {
            uint8_t data = rxBuffer[rxTail];
            rxTail = (uint16_t)((rxTail + 1U) % RX_BUFFER_SIZE);
            ProcessWemosByte(data);
        }

        /* 2. PC / PUTTY INPUT */
        if (HAL_UART_Receive(&huart2, &pcData, 1, 1) == HAL_OK)
        {
            if (pcData == '\r' || pcData == '\n')
            {
                if (pcData == '\n' && ignoreNextLF)
                {
                    ignoreNextLF = 0;
                }
                else
                {
                    if (pcData == '\r')
                    {
                        ignoreNextLF = 1;
                    }
                    else
                    {
                        ignoreNextLF = 0;
                    }

                    const char newline[] = "\r\n";
                    HAL_UART_Transmit(&huart2, (uint8_t *)newline, 2, HAL_MAX_DELAY);

                    if (commandLength > 0)
                    {
                        HAL_UART_Transmit(&huart1, (uint8_t *)commandBuffer, commandLength, HAL_MAX_DELAY);
                        HAL_UART_Transmit(&huart1, (uint8_t *)newline, 2, HAL_MAX_DELAY);
                        commandLength = 0;
                    }
                }
            }
            else if (pcData == 8 || pcData == 127)
            {
                if (commandLength > 0)
                {
                    commandLength--;
                    const char erase[] = "\b \b";
                    HAL_UART_Transmit(&huart2, (uint8_t *)erase, 3, HAL_MAX_DELAY);
                }
                ignoreNextLF = 0;
            }
            else
            {
                ignoreNextLF = 0;
                if (commandLength < COMMAND_SIZE - 1)
                {
                    commandBuffer[commandLength++] = (char)pcData;
                    HAL_UART_Transmit(&huart2, &pcData, 1, HAL_MAX_DELAY);
                }
            }
        }

        /* 3. RECEIVE-BUFFER OVERFLOW WARNING */
        if (rxOverflow)
        {
            const char warning[] = "\r\nWARNING: Wemos UART buffer overflow\r\n";
            HAL_UART_Transmit(&huart2, (uint8_t *)warning, sizeof(warning) - 1, 100);
            rxOverflow = 0;
        }
    }
}

void SystemClock_Config(void)
{
    RCC_OscInitTypeDef RCC_OscInitStruct = {0};
    RCC_ClkInitTypeDef RCC_ClkInitStruct = {0};

#if defined(RCC_PLLP_DIV2)
    __HAL_RCC_PWR_CLK_ENABLE();
    __HAL_PWR_VOLTAGESCALING_CONFIG(PWR_REGULATOR_VOLTAGE_SCALE2);

    RCC_OscInitStruct.OscillatorType = RCC_OSCILLATORTYPE_HSE;
    RCC_OscInitStruct.HSEState = RCC_HSE_BYPASS;
    RCC_OscInitStruct.PLL.PLLState = RCC_PLL_ON;
    RCC_OscInitStruct.PLL.PLLSource = RCC_PLLSOURCE_HSE;
    RCC_OscInitStruct.PLL.PLLM = 4;
    RCC_OscInitStruct.PLL.PLLN = 84;
    RCC_OscInitStruct.PLL.PLLP = RCC_PLLP_DIV2;
    RCC_OscInitStruct.PLL.PLLQ = 4;

    if (HAL_RCC_OscConfig(&RCC_OscInitStruct) != HAL_OK)
    {
        Error_Handler();
    }

    RCC_ClkInitStruct.ClockType = RCC_CLOCKTYPE_HCLK | RCC_CLOCKTYPE_SYSCLK | RCC_CLOCKTYPE_PCLK1 | RCC_CLOCKTYPE_PCLK2;
    RCC_ClkInitStruct.SYSCLKSource = RCC_SYSCLKSOURCE_PLLCLK;
    RCC_ClkInitStruct.AHBCLKDivider = RCC_SYSCLK_DIV1;
    RCC_ClkInitStruct.APB1CLKDivider = RCC_HCLK_DIV2;
    RCC_ClkInitStruct.APB2CLKDivider = RCC_HCLK_DIV1;

    if (HAL_RCC_ClockConfig(&RCC_ClkInitStruct, FLASH_LATENCY_2) != HAL_OK)
    {
        Error_Handler();
    }
#elif defined(RCC_PLL_MUL16) && defined(RCC_PLLSOURCE_HSI_DIV2)
    RCC_OscInitStruct.OscillatorType = RCC_OSCILLATORTYPE_HSI;
    RCC_OscInitStruct.HSIState = RCC_HSI_ON;
    RCC_OscInitStruct.HSICalibrationValue = RCC_HSICALIBRATION_DEFAULT;
    RCC_OscInitStruct.PLL.PLLState = RCC_PLL_ON;
    RCC_OscInitStruct.PLL.PLLSource = RCC_PLLSOURCE_HSI_DIV2;
    RCC_OscInitStruct.PLL.PLLMUL = RCC_PLL_MUL16;

    if (HAL_RCC_OscConfig(&RCC_OscInitStruct) != HAL_OK)
    {
        Error_Handler();
    }

    RCC_ClkInitStruct.ClockType = RCC_CLOCKTYPE_HCLK | RCC_CLOCKTYPE_SYSCLK | RCC_CLOCKTYPE_PCLK1 | RCC_CLOCKTYPE_PCLK2;
    RCC_ClkInitStruct.SYSCLKSource = RCC_SYSCLKSOURCE_PLLCLK;
    RCC_ClkInitStruct.AHBCLKDivider = RCC_SYSCLK_DIV1;
    RCC_ClkInitStruct.APB1CLKDivider = RCC_HCLK_DIV2;
    RCC_ClkInitStruct.APB2CLKDivider = RCC_HCLK_DIV1;

    if (HAL_RCC_ClockConfig(&RCC_ClkInitStruct, FLASH_LATENCY_2) != HAL_OK)
    {
        Error_Handler();
    }
#endif
}

static void MX_USART1_UART_Init(void)
{
    huart1.Instance = USART1;
    huart1.Init.BaudRate = 115200;
    huart1.Init.WordLength = UART_WORDLENGTH_8B;
    huart1.Init.StopBits = UART_STOPBITS_1;
    huart1.Init.Parity = UART_PARITY_NONE;
    huart1.Init.Mode = UART_MODE_TX_RX;
    huart1.Init.HwFlowCtl = UART_HWCONTROL_NONE;
    huart1.Init.OverSampling = UART_OVERSAMPLING_16;

    if (HAL_UART_Init(&huart1) != HAL_OK)
    {
        Error_Handler();
    }
}

static void MX_USART2_UART_Init(void)
{
    huart2.Instance = USART2;
    huart2.Init.BaudRate = 115200;
    huart2.Init.WordLength = UART_WORDLENGTH_8B;
    huart2.Init.StopBits = UART_STOPBITS_1;
    huart2.Init.Parity = UART_PARITY_NONE;
    huart2.Init.Mode = UART_MODE_TX_RX;
    huart2.Init.HwFlowCtl = UART_HWCONTROL_NONE;
    huart2.Init.OverSampling = UART_OVERSAMPLING_16;

    if (HAL_UART_Init(&huart2) != HAL_OK)
    {
        Error_Handler();
    }
}

static void MX_GPIO_Init(void)
{
#ifdef __HAL_RCC_GPIOH_CLK_ENABLE
    __HAL_RCC_GPIOH_CLK_ENABLE();
#endif
#ifdef __HAL_RCC_GPIOD_CLK_ENABLE
    __HAL_RCC_GPIOD_CLK_ENABLE();
#endif
    __HAL_RCC_GPIOA_CLK_ENABLE();
    __HAL_RCC_GPIOB_CLK_ENABLE();
}

void Error_Handler(void)
{
    __disable_irq();
    while (1)
    {
    }
}

#ifdef USE_FULL_ASSERT
void assert_failed(uint8_t *file, uint32_t line)
{
}
#endif